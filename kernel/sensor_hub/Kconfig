## kernel/sensor_hub/Kconfig
```kconfig
config SENSOR_HUB
	tristate "Sensor hub driver"
	depends on GPIOLIB && I2C && PWM
	help
	  Unified hub driver for PIR + SHT20 inputs and PWM-driven outputs.
```
